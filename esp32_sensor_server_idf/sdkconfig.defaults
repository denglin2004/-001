## esp32_sensor_server_idf/sdkconfig.defaults
```kconfig
# ESP32 默认配置
CONFIG_ESP32_DEFAULT_CPU_FREQ_240=y

# WiFi 配置
CONFIG_ESP_WIFI_AUTH_WPA2_PSK=y

# HTTP Server 配置
CONFIG_HTTPD_MAX_REQ_HDR_LEN=512
CONFIG_HTTPD_MAX_URI_LEN=512

# 启用文件系统
CONFIG_PARTITION_TABLE_CUSTOM=y
CONFIG_PARTITION_TABLE_CUSTOM_FILENAME="partitions.csv"
CONFIG_PARTITION_TABLE_FILENAME="partitions.csv"

# 启用 cJSON
CONFIG_JSON_LIBRARY=y
```
